## boards/shields/dongle_display/Kconfig.defconfig
```kconfig
# Copyright (c) 2024 The ZMK Contributors
# SPDX-License-Identifier: MIT

if SHIELD_DONGLE_DISPLAY

choice ZMK_DISPLAY_STATUS_SCREEN
    default ZMK_DISPLAY_STATUS_SCREEN_CUSTOM
endchoice

config ZMK_DISPLAY_STATUS_SCREEN_CUSTOM
    select LV_USE_LABEL
    select LV_USE_IMAGE
    select LV_USE_CANVAS
    select LV_USE_ANIMIMG 
    select LV_USE_ANIMATION
    select LV_USE_LINE 
    select LV_FONT_UNSCII_8
    select ZMK_WPM
    imply ZMK_HID_INDICATORS

config ZMK_DONGLE_DISPLAY_DONGLE_BATTERY
    bool "Show also the battery level of the dongle"
    depends on BT && (!ZMK_SPLIT_BLE || ZMK_SPLIT_ROLE_CENTRAL)

choice ZMK_DONGLE_DISPLAY_BATTERY_ICON
    prompt "Battery icon"
    default ZMK_DONGLE_DISPLAY_BATTERY_ICON_CLASSIC

config ZMK_DONGLE_DISPLAY_BATTERY_ICON_CLASSIC
    bool "Small vertical icon (5x8)"

config ZMK_DONGLE_DISPLAY_BATTERY_ICON_HORIZONTAL
    bool "Horizontal icon with an outline, sized by ZMK_DONGLE_DISPLAY_BATTERY_WIDTH/HEIGHT"

config ZMK_DONGLE_DISPLAY_BATTERY_ICON_NONE
    bool "No icon, only the percentage"

endchoice

if ZMK_DONGLE_DISPLAY_BATTERY_ICON_HORIZONTAL

config ZMK_DONGLE_DISPLAY_BATTERY_WIDTH
    int "Battery icon width in pixels, including the terminal"
    default 12
    range 10 40

config ZMK_DONGLE_DISPLAY_BATTERY_HEIGHT
    int "Battery icon height in pixels"
    default 6
    range 4 20

config ZMK_DONGLE_DISPLAY_BATTERY_SEGMENTS
    int "Split the fill into this many sections (0: solid fill)"
    default 0
    range 0 10
    help
        The sections are 1px apart from each other and from the outline.
        Any charge above 0 lights at least one.

config ZMK_DONGLE_DISPLAY_BATTERY_PERCENT_INSIDE
    bool "Show the percentage inside the icon instead of a fill"
    help
        Needs an icon of about 32x12 to fit "100".

endif

config ZMK_DONGLE_DISPLAY_BATTERY_SHOW_PERCENT
    bool "Show the battery percentage next to the icon"
    default y
    help
        Always shown without an icon.

config ZMK_DONGLE_DISPLAY_BATTERY_SIDE_BY_SIDE
    bool "Show the batteries next to each other instead of one per row"
    help
        The first paired peripheral is on the left.

config ZMK_DONGLE_DISPLAY_BATTERY_SWAP_SIDES
    bool "Reverse the order of the peripherals' batteries"
    help
        Peripherals are ordered by when they were first paired with the dongle.
        For a split keyboard whose right half was paired first, this puts the
        left half first.

config ZMK_DONGLE_DISPLAY_BATTERY_SHOW_DISCONNECTED
    bool "Show an X for a peripheral that isn't connected, instead of hiding it"

config ZMK_DONGLE_DISPLAY_MAC_MODIFIERS
    bool "Use MacOS modifier symbols instead of the Windows symbols"

config ZMK_DONGLE_DISPLAY_BONGO_CAT
    bool "Display the Bongo Cat widget"
    default y

config ZMK_DONGLE_DISPLAY_MODIFIERS
    bool "Display the modifiers widget"
    default y

config ZMK_DONGLE_DISPLAY_LAYER
    bool "Display the highest layer widget"
    default y

config ZMK_DONGLE_DISPLAY_LAYER_NAME_SCROLL_WIDTH
    int "Width for layer name label (in pixels)"
    default 50
    help
        Width in pixels for the layer name label. When the layer name
        exceeds this width, it will scroll horizontally in a circular pattern.

config ZMK_DONGLE_DISPLAY_LAYER_TEXT_ALIGN
    string "Layer name text alignment"
    default "left"
    help
        Text alignment for the layer name label. Valid values: "left", "center", "right".

config ZMK_DONGLE_DISPLAY_WPM
    bool "Display the WPM widget"
    default n

config ZMK_DONGLE_DISPLAY_WPM_DISABLED_LAYERS
    string "Layers in which the widget is disabled, comma separated"
    default ""

choice ZMK_DISPLAY_WORK_QUEUE
    default ZMK_DISPLAY_WORK_QUEUE_DEDICATED
endchoice

config LV_Z_MEM_POOL_SIZE
    default 16384

config LV_Z_VDB_SIZE
    default 100

config LV_DPI_DEF
    default 148

config LV_Z_BITS_PER_PIXEL
    default 1

choice LV_COLOR_DEPTH
    default LV_COLOR_DEPTH_1
endchoice

endif
```

## tools/oled-sim/module/Kconfig
```kconfig
config OLED_SIM
    bool "Simulated OLED for native_posix renders"
    default y
    depends on DT_HAS_ZMK_OLED_SIM_ENABLED
```

## tools/oled-sim/module/dts/bindings/display/zmk,oled-sim.yaml
```yaml
description: In-memory monochrome display that prints its contents on request (host builds only)

compatible: "zmk,oled-sim"

include: display-controller.yaml
```
